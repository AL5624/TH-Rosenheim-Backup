#include <arduino.h>
#include <Adafruit_GFX.h>
#include <Adafruit_SSD1306.h>
#include "DisplaySSD1306Adapter.h"
#include <Wire.h>


#define LCD_WIDTH 128
#define LCD_HEIGHT 32
#define OLED_RESET -1
#define DISPLAY_ADDRESS 0x3C




static const unsigned char PROGMEM heartEmpty[] =  // bitmap images loaded onto display:
        {
            0x00, 0x00, 0x00, 0x00, 0x00, 0x00, 0x00, 0x00, 0x00, 0x00, 0x00, 0x00, 0x00, 0xE0, 0x0E, 0x00,
            0x03, 0xFC, 0x7F, 0x80, 0x07, 0xFE, 0xFF, 0xE0, 0x0F, 0xFF, 0xFF, 0xE0, 0x1F, 0xFF, 0xFF, 0xF0,
            0x1F, 0xBF, 0xFB, 0xF0, 0x3F, 0x0F, 0xE1, 0xF8, 0x3E, 0x0F, 0xE0, 0xF8, 0x3E, 0x07, 0xC0, 0xF8,
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            0x00, 0x0F, 0xE0, 0x00, 0x00, 0x03, 0x80, 0x00, 0x00, 0x00, 0x00, 0x00, 0x00, 0x00, 0x00, 0x00
        };

static const unsigned char PROGMEM heartFilled[] =
        {
            0x00, 0x00, 0x00, 0x00, 0x00, 0x00, 0x00, 0x00, 0x00, 0x00, 0x00, 0x00, 0x00, 0xE0, 0x0E, 0x00,
            0x03, 0xFC, 0x7F, 0x80, 0x07, 0xFE, 0xFF, 0xE0, 0x0F, 0xFF, 0xFF, 0xE0, 0x1F, 0xFF, 0xFF, 0xF0,
            0x1F, 0xFF, 0xFF, 0xF0, 0x3F, 0xFF, 0xFF, 0xF8, 0x3F, 0xFF, 0xFF, 0xF8, 0x3F, 0xFF, 0xFF, 0xF8,
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            0x00, 0x0F, 0xE0, 0x00, 0x00, 0x03, 0x80, 0x00, 0x00, 0x00, 0x00, 0x00, 0x00, 0x00, 0x00, 0x00
        };

const int button = PIND2;
const int debounceMs = 50;

volatile unsigned long millisLastInterrupt;
volatile bool buttonPressed;

bool heartOn = false;

Adafruit_SSD1306 display(LCD_WIDTH, LCD_HEIGHT, &Wire, OLED_RESET);
DisplaySSD1036Adapter display2(display, DISPLAY_ADDRESS, 32);

/*
 * Keep interrupt service routines as fast and short as possible.
 * While servicing an interrupt, the CPU can't service other interrupts.
 * The flag buttonPressed is used to signal that the button was pressed.
 * This avoids having the usually slow logging in an ISR.
 * It is instead handled asynchronously in the loop function.
 */
void buttonPressedISR() {
    unsigned long interruptTime = millis();

    if (interruptTime - millisLastInterrupt > debounceMs) {
        buttonPressed = true;
    }
    millisLastInterrupt = interruptTime;
}
/*
 * Everything is set up and set to a known state.
 * The LED pin is set to LOW to ensure that the LED always starts powered off.
 * Rising edge triggering is used in this example to determine, i.e. trigger at,
 * the end of a button press.
 * Falling edge triggering could be used instead to determine, i.e. trigger at,
 * the beginning of a button press.
 */
void setup() {
    // put your setup code here, to run once:
    Serial.begin(9600);

    pinMode(button, INPUT_PULLUP);
    buttonPressed = false;

    display2.initialze();

    millisLastInterrupt = 0;
    attachInterrupt(digitalPinToInterrupt(button),
                    buttonPressedISR,
                    RISING);
}

void loop() {
    // put your main code here, to run repeatedly:
    if (buttonPressed) {
        Serial.println("Button was pressed.");

        if (heartOn) {
            Serial.println("Empty Heart ... BPM 1");
            unsigned char msg[] = "BPM 1";

            display2.print(heartEmpty, msg, 5);
            heartOn = false;
        } else {
            Serial.println("Filled Heart ... BPM 2");
            unsigned char msg[] = "BPM 2";

            display2.print(heartFilled, msg, 5);
            heartOn = true;
        }

        buttonPressed = false;
    }
}